#include <Adafruit_GFX.h>
#include <Adafruit_NeoMatrix.h>
#include <Adafruit_NeoPixel.h>
#include <Metro.h>
#ifndef PSTR
  #define PSTR
#endif
#define PIN 6
Adafruit_NeoMatrix matrix = Adafruit_NeoMatrix(16, 16, PIN, NEO_MATRIX_TOP + NEO_MATRIX_LEFT + NEO_MATRIX_COLUMNS + NEO_MATRIX_ZIGZAG, NEO_GRB + NEO_KHZ800);
const unsigned char angrysketchRedFrame0[16*16] = {0,0,0,0,0,0,0,0,0,0,0,0,0,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0,0};
const unsigned char angrysketchGreenFrame0[16*16] = {0,0,0,0,0,0,0,0,0,0,0,0,0,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0,0};
const unsigned char angrysketchBlueFrame0[16*16] = {0,0,0,0,0,0,0,0,0,0,0,0,0,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0,0};

const unsigned char happysketchRedFrame0[16*16] = {0,0,0,0,0,0,0,0,0,0,0,0,0,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0,0};
const unsigned char happysketchGreenFrame0[16*16] = {0,0,0,0,0,0,0,0,0,0,0,0,0,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0,0};
const unsigned char happysketchBlueFrame0[16*16] = {0,0,0,0,0,0,0,0,0,0,0,0,0,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0,0};
    
char byteRead;

Metro AnimateTimer = Metro(10);
byte FrameNumber = 0;
void setup() {
  Serial.begin(115200);
  matrix.begin();
  matrix.setBrightness(30);
  matrix.fillScreen(0);
  matrix.show();
}
void loop() {
  if (Serial.available()) {
    byteRead = Serial.read();
  }
  
  // byteRead = byteRead;
  
  //angry face
  if (byteRead=='0'){
    //Adafruit_NeoMatrix matrix = Adafruit_NeoMatrix(16, 16, PIN, NEO_MATRIX_TOP + NEO_MATRIX_LEFT + NEO_MATRIX_COLUMNS + NEO_MATRIX_ZIGZAG, NEO_GRB + NEO_KHZ800);
    const unsigned char angrysketchRedFrame0[16*16] = {0,0,0,0,0,0,0,0,0,0,0,0,0,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0,0};
    const unsigned char angrysketchGreenFrame0[16*16] = {0,0,0,0,0,0,0,0,0,0,0,0,0,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0,0};
    const unsigned char angrysketchBlueFrame0[16*16] = {0,0,0,0,0,0,0,0,0,0,0,0,0,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0,0};

    if (AnimateTimer.check() == 1) {
      TimerEvent_angry();
    }
  }
  
  //happy face
  else if (byteRead=='1'){
    
    //Adafruit_NeoMatrix matrix = Adafruit_NeoMatrix(16, 16, PIN, NEO_MATRIX_TOP + NEO_MATRIX_LEFT + NEO_MATRIX_COLUMNS + NEO_MATRIX_ZIGZAG, NEO_GRB + NEO_KHZ800);
    const unsigned char happysketchRedFrame0[16*16] = {0,0,0,0,0,0,0,0,0,0,0,0,0,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0,0};
    const unsigned char happysketchGreenFrame0[16*16] = {0,0,0,0,0,0,0,0,0,0,0,0,0,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0,0};
    const unsigned char happysketchBlueFrame0[16*16] = {0,0,0,0,0,0,0,0,0,0,0,0,0,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0,0};
    
  
    
    if (AnimateTimer.check() == 1) {
      TimerEvent_happy();
    }
  }
  
  else if (byteRead=='1'){
    
    //Adafruit_NeoMatrix matrix = Adafruit_NeoMatrix(16, 16, PIN, NEO_MATRIX_TOP + NEO_MATRIX_LEFT + NEO_MATRIX_COLUMNS + NEO_MATRIX_ZIGZAG, NEO_GRB + NEO_KHZ800);
    const unsigned char happysketchRedFrame0[16*16] = {0,0,0,0,0,0,0,0,0,0,0,0,0,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0,0};
    const unsigned char happysketchGreenFrame0[16*16] = {0,0,0,0,0,0,0,0,0,0,0,0,0,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0,0};
    const unsigned char happysketchBlueFrame0[16*16] = {0,0,0,0,0,0,0,0,0,0,0,0,0,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0,0};
    
  
    
    if (AnimateTimer.check() == 1) {
      TimerEvent_happy();
    }
  }
  
  delay(10);
 }


uint16_t drawRGB24toRGB565(byte r, byte g, byte b) {
  return ((r / 8) << 11) | ((g / 4) << 5) | (b / 8);
}
void TimerEvent_angry() {
      for (byte y = 0; y < 16; y++) {
        for (byte x = 0; x < 16; x++) {
          byte loc = x + y*16;
          matrix.drawPixel(x, y, drawRGB24toRGB565((angrysketchRedFrame0[loc]), (angrysketchGreenFrame0[loc]), (angrysketchBlueFrame0[loc])));
        }
      }
     matrix.show();
  }
  
 void TimerEvent_happy() {
      for (byte y = 0; y < 16; y++) {
        for (byte x = 0; x < 16; x++) {
          byte loc = x + y*16;
          matrix.drawPixel(x, y, drawRGB24toRGB565((happysketchRedFrame0[loc]), (happysketchGreenFrame0[loc]), (happysketchBlueFrame0[loc])));
        }
      }
     matrix.show();
  }

